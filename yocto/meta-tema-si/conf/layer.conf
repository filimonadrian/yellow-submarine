## yocto/meta-tema-si/conf/layer.conf
```bitbake
# We have a conf and classes directory, add to BBPATH
BBPATH .= ":${LAYERDIR}"

# We have recipes-* directories, add to BBFILES
BBFILES += "${LAYERDIR}/recipes-*/*/*.bb \
            ${LAYERDIR}/recipes-*/*/*.bbappend"

BBFILE_COLLECTIONS += "meta-tema-si"
BBFILE_PATTERN_meta-tema-si = "^${LAYERDIR}/"
BBFILE_PRIORITY_meta-tema-si = "6"

LAYERDEPENDS_meta-tema-si = "core"
LAYERSERIES_COMPAT_meta-tema-si = "dunfell"
```
